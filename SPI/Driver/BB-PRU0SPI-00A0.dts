/*
 * Written by Vaibhav Choudhary under GSOC-2016 for BeagleBoard.org
 * Copyright (C) 2016 Vaibhav Choudhary -www.vaibhavchoudhary.com
 *
 * This code may be copied and/or modified freely according to GNU General Public  
 * License version 2 as published by the Free Software Foundation, provided   
 * the following conditions are also met:
 * 1) Redistributions/adaptions of source code must retain this copyright
 *    notice on the top, giving credit to the original author, along with 
 *    this list of conditions.
 *
 * 2) Redistributions in binary form, compiled from this source code and/or 
 *    modified/adapted versions of this source code, must include this copyright 
 *    notice giving credit to the original author, along with this list of conditions 
 *    in the documentation and other materials provided with the
 *    distribution.
 *
 * 3) The original author shall not held for any loss arising from using this code.
 *    This program is distributed in the hope that it will be useful,
 *    but WITHOUT ANY WARRANTY; without even the implied warranty of
 *    MERCHANTABILITY or FITNESS FOR A PARTICULAR PURPOSE
 */
 
/dts-v1/;
/plugin/;

/ {
	compatible = "ti,beaglebone", "ti,beaglebone-black", "beagle,pru0-spi";

	/* Identification */
	part-number = "bb-pru0-spi";
	version = "00A0";

	fragment@1 {
		target = <&ocp>;
		__overlay__ {
			pru-spi {
				#address-cells = <1>;
				#size-cells = <0>;
				num-cs = <2>;

				compatible = "beagle,pru0-spi";

				spidev@0 {
					compatible = "linux,spidev";
					spi-max-frequency = <50000000>;
					reg = <0>;
				};
			};
		};
	};
};
